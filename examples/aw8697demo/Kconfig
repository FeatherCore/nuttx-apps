## examples/aw8697demo/Kconfig
```kconfig
#
# For a description of the syntax of this configuration file,
# see the file kconfig-language.txt in the NuttX tools repository.
#

config EXAMPLES_AW8697DEMO
	tristate "AW8697 haptic demo"
	default n
	depends on INPUT_FF && FF_AW8697
	---help---
		Enable a small AW8697 force-feedback demo command for NSH.

if EXAMPLES_AW8697DEMO

config EXAMPLES_AW8697DEMO_PROGNAME
	string "Program name"
	default "aw8697demo"
	---help---
		This is the name of the program that will be used in NSH.

config EXAMPLES_AW8697DEMO_PRIORITY
	int "AW8697 demo task priority"
	default 100

config EXAMPLES_AW8697DEMO_STACKSIZE
	int "AW8697 demo stack size"
	default DEFAULT_TASK_STACKSIZE

config EXAMPLES_AW8697DEMO_DEVPATH
	string "AW8697 device path"
	default "/dev/input0"

config EXAMPLES_AW8697DEMO_DURATION_MS
	int "Default vibration duration in milliseconds"
	default 120

config EXAMPLES_AW8697DEMO_STRENGTH
	int "Default vibration strength"
	default 32767
	range 1 65535

endif
```

## examples/esp32_wifi_demo/Kconfig
```kconfig
#
# For a description of the syntax of this configuration file,
# see the file kconfig-language.txt in the NuttX tools repository.
#

config EXAMPLES_ESP32_WIFI_DEMO
	tristate "ESP32-C5 ESP-Hosted NG Wi-Fi demo"
	default n
	depends on NET
	select NETUTILS_NETLIB
	select WIRELESS_ESP_HOSTED_NG
	---help---
		Enable an NSH command used to exercise the ESP32-C5 ESP-Hosted NG
		host path.  The command configures the expected wlan interface,
		sets STA mode/SSID through wireless ioctls, and applies IPv4
		settings for bring-up tests.

if EXAMPLES_ESP32_WIFI_DEMO

config EXAMPLES_ESP32_WIFI_DEMO_PROGNAME
	string "Program name"
	default "esp32_wifi_demo"

config EXAMPLES_ESP32_WIFI_DEMO_PRIORITY
	int "ESP32 Wi-Fi demo task priority"
	default 100

config EXAMPLES_ESP32_WIFI_DEMO_STACKSIZE
	int "ESP32 Wi-Fi demo stack size"
	default DEFAULT_TASK_STACKSIZE

config EXAMPLES_ESP32_WIFI_DEMO_IFNAME
	string "Wi-Fi interface name"
	default "wlan0"

config EXAMPLES_ESP32_WIFI_DEMO_SSID
	string "Default SSID"
	default "nuttx-esp32"

config EXAMPLES_ESP32_WIFI_DEMO_IPADDR
	string "Static IPv4 address"
	default "192.168.50.20"

config EXAMPLES_ESP32_WIFI_DEMO_NETMASK
	string "Static IPv4 netmask"
	default "255.255.255.0"

config EXAMPLES_ESP32_WIFI_DEMO_GATEWAY
	string "Static IPv4 gateway"
	default "192.168.50.1"

endif
```

## examples/fgfx_demo/Kconfig
```kconfig
#
# For a description of the syntax of this configuration file,
# see the file kconfig-language.txt in the NuttX tools repository.
#

config EXAMPLES_FGFX_DEMO
	tristate "FGFX framebuffer demo"
	default n
	depends on GRAPHICS_FGFX
	depends on VIDEO_FB
	---help---
		Build a small FGFX framebuffer demo.  It opens a framebuffer device,
		renders animated FGFX display-list content into an RGBA surface, and
		copies the result into the framebuffer.

if EXAMPLES_FGFX_DEMO

config EXAMPLES_FGFX_DEMO_PROGNAME
	string "Program name"
	default "fgfxdemo"

config EXAMPLES_FGFX_DEMO_PRIORITY
	int "Task priority"
	default 100

config EXAMPLES_FGFX_DEMO_STACKSIZE
	int "Stack size"
	default 32768

config EXAMPLES_FGFX_DEMO_FBDEV
	string "Framebuffer device"
	default "/dev/fb0"

config EXAMPLES_FGFX_DEMO_FRAMES
	int "Frame count"
	default 0
	---help---
		Number of animation frames to render.  Zero means run until the
		simulator is stopped.

config EXAMPLES_FGFX_DEMO_FRAME_DELAY_US
	int "Frame delay in microseconds"
	default 33000

endif
```

## examples/frender_demo/Kconfig
```kconfig
#
# For a description of the syntax of this configuration file,
# see the file kconfig-language.txt in the NuttX tools repository.
#

config EXAMPLES_FRENDER_DEMO
	tristate "FRender standalone demo"
	default n
	select GRAPHICS_FRENDER
	select GRAPHICS_FRENDER_FB
	---help---
		Enable a minimal NSH-runnable FRender demo.

		The demo builds a backend-neutral command list, dispatches it through
		the FRender framebuffer backend to nuttx/graphics, and prints
		checksum information.

if EXAMPLES_FRENDER_DEMO

config EXAMPLES_FRENDER_DEMO_PROGNAME
	string "Program name"
	default "frender_demo"

config EXAMPLES_FRENDER_DEMO_PRIORITY
	int "FRender demo task priority"
	default 100

config EXAMPLES_FRENDER_DEMO_STACKSIZE
	int "FRender demo stack size"
	default DEFAULT_TASK_STACKSIZE

config EXAMPLES_FRENDER_DEMO_WIDTH
	int "Demo surface width"
	default 320

config EXAMPLES_FRENDER_DEMO_HEIGHT
	int "Demo surface height"
	default 240

endif
```

## examples/hwsim_testmode/Kconfig
```kconfig
#
# For a description of the syntax of this configuration file,
# see the file kconfig-language.txt in the NuttX tools repository.
#

config EXAMPLES_HWSIM_TESTMODE
	tristate "mac80211_hwsim nl80211 testmode helper"
	default n
	depends on NET
	depends on NETLINK_GENERIC
	depends on WIRELESS_WIFI_LIBNL
	depends on NL80211_TESTMODE
	---help---
		Enable a small NSH command that sends mac80211_hwsim private
		nl80211 testmode commands.  It is intended for simulator
		validation of hwsim-only hooks such as SET_PS/GET_PS.

if EXAMPLES_HWSIM_TESTMODE

config EXAMPLES_HWSIM_TESTMODE_PROGNAME
	string "Program name"
	default "hwsim_tm"

config EXAMPLES_HWSIM_TESTMODE_PRIORITY
	int "hwsim testmode task priority"
	default 100

config EXAMPLES_HWSIM_TESTMODE_STACKSIZE
	int "hwsim testmode stack size"
	default 8192

config EXAMPLES_HWSIM_TESTMODE_IFNAME
	string "Default interface name"
	default "wlan0"

endif
```

## examples/nemap_demo/Kconfig
```kconfig
#
# For a description of the syntax of this configuration file,
# see the file kconfig-language.txt in the NuttX tools repository.
#

config EXAMPLES_NEMAP_DEMO
	tristate "NemaP/GPU2D validation demo"
	default n
	depends on EXAMPLES_NEMAP_DEMO_HAVE_BACKEND
	depends on VIDEO_FB
	---help---
		Build a small NemaP/GPU2D validation command.  This demo opens
		/dev/fb0 to prove the screen path is initialized, reads GPU2D
		identity/configuration registers, initializes the selected STM32
		low-level GPU2D root ring, submits command-list tests, and waits
		for the GPU2D completion interrupt.

if EXAMPLES_NEMAP_DEMO

config EXAMPLES_NEMAP_DEMO_STM32U5
	bool "STM32U5 GPU2D backend"
	default y
	depends on ARCH_CHIP_STM32U5
	depends on STM32U5_GPU2D
	---help---
		Use the STM32U5 private GPU2D register and command-list backend.

config EXAMPLES_NEMAP_DEMO_STM32N6
	bool "STM32N6 GPU2D backend"
	default y
	depends on ARCH_CHIP_STM32N6
	depends on STM32N6_GPU2D
	---help---
		Use the STM32N6 private GPU2D register and command-list backend.

config EXAMPLES_NEMAP_DEMO_STM32H7RS
	bool "STM32H7RS GPU2D backend"
	default y
	depends on ARCH_CHIP_STM32H7RS
	depends on STM32H7RS_GPU2D
	---help---
		Use the STM32H7RS private GPU2D register and command-list backend.

config EXAMPLES_NEMAP_DEMO_PROGNAME
	string "Program name"
	default "nemap_demo"

config EXAMPLES_NEMAP_DEMO_PRIORITY
	int "Task priority"
	default 100

config EXAMPLES_NEMAP_DEMO_STACKSIZE
	int "Stack size"
	default 4096

config EXAMPLES_NEMAP_DEMO_FBDEV
	string "Framebuffer device"
	default "/dev/fb0"

config EXAMPLES_NEMAP_DEMO_TIMEOUT_MS
	int "GPU2D wait timeout in milliseconds"
	default 1000

config EXAMPLES_NEMAP_DEMO_RUN_VERIFIED_PHASES
	bool "Run verified NemaP/GPU2D regression phases"
	default n
	---help---
		Run the already validated phase 5-18 regression demos.  Keep this
		disabled during bring-up so nemap_demo only executes the mandatory
		identity/IRQ phases and any newly added development phases.  Enable
		it when a full GPU2D regression pass is needed.

config EXAMPLES_NEMAP_DEMO_RUN_OFFSCREEN_PHASES
	bool "Run offscreen scratch-buffer phases"
	default y
	---help---
		Run phases that target the demo's private offscreen resources.
		STM32U5 uses static scratch arrays.  STM32N6 and STM32H7RS place
		the resources in PSRAM after the framebuffer and before the PSRAM
		heap so the AXI GPU2D path can access them.

endif

config EXAMPLES_NEMAP_DEMO_HAVE_BACKEND
	bool
	default y if ARCH_CHIP_STM32U5 && STM32U5_GPU2D
	default y if ARCH_CHIP_STM32N6 && STM32N6_GPU2D
	default y if ARCH_CHIP_STM32H7RS && STM32H7RS_GPU2D
```

## examples/pinion_demo/Kconfig
```kconfig
#
# For a description of the syntax of this configuration file,
# see the file kconfig-language.txt in the NuttX tools repository.
#

config EXAMPLES_PINION_DEMO
	tristate "Pinion framebuffer game demo"
	default n
	depends on GRAPHICS_PINION
	depends on VIDEO_FB
	---help---
		Build a small Pinion demo.  It opens a framebuffer device,
		renders animated Pinion surface content, and copies the result into
		the framebuffer.

if EXAMPLES_PINION_DEMO

config EXAMPLES_PINION_DEMO_PROGNAME
	string "Program name"
	default "piniondemo"

config EXAMPLES_PINION_DEMO_PRIORITY
	int "Task priority"
	default 100

config EXAMPLES_PINION_DEMO_STACKSIZE
	int "Stack size"
	default 16384

config EXAMPLES_PINION_DEMO_FBDEV
	string "Framebuffer device"
	default "/dev/fb0"

config EXAMPLES_PINION_DEMO_FRAMES
	int "Frame count"
	default 0
	---help---
		Number of animation frames to render.  Zero means run until the
		simulator is stopped.

config EXAMPLES_PINION_DEMO_FRAME_DELAY_US
	int "Frame delay in microseconds"
	default 33000

endif # EXAMPLES_PINION_DEMO
```

## examples/wifi_hwsim_ap/Kconfig
```kconfig
#
# For a description of the syntax of this configuration file,
# see the file kconfig-language.txt in the NuttX tools repository.
#

config EXAMPLES_WIFI_HWSIM_AP
	tristate "Wi-Fi hwsim AP demo"
	default n
	depends on NET
	select NETUTILS_NETLIB
	---help---
		Enable a small NSH command used to bring up and inspect the AP
		side of the NuttX sim Wi-Fi hwsim experiment.

if EXAMPLES_WIFI_HWSIM_AP

config EXAMPLES_WIFI_HWSIM_AP_PROGNAME
	string "Program name"
	default "wifi_ap_demo"

config EXAMPLES_WIFI_HWSIM_AP_PRIORITY
	int "AP demo task priority"
	default 100

config EXAMPLES_WIFI_HWSIM_AP_STACKSIZE
	int "AP demo stack size"
	default DEFAULT_TASK_STACKSIZE

config EXAMPLES_WIFI_HWSIM_AP_IFNAME
	string "AP interface name"
	default "wlan0"

config EXAMPLES_WIFI_HWSIM_AP_IPADDR
	string "AP IPv4 address"
	default "192.168.201.1"

config EXAMPLES_WIFI_HWSIM_AP_NETMASK
	string "AP IPv4 netmask"
	default "255.255.255.0"

config EXAMPLES_WIFI_HWSIM_AP_SSID
	string "AP SSID"
	default "nuttx-hwsim"

config EXAMPLES_WIFI_HWSIM_AP_STA1
	string "STA1 IPv4 address"
	default "192.168.201.2"

config EXAMPLES_WIFI_HWSIM_AP_STA2
	string "STA2 IPv4 address"
	default "192.168.201.3"

endif
```

## examples/wifi_hwsim_sta/Kconfig
```kconfig
#
# For a description of the syntax of this configuration file,
# see the file kconfig-language.txt in the NuttX tools repository.
#

config EXAMPLES_WIFI_HWSIM_STA
	tristate "Wi-Fi hwsim STA demo"
	default n
	depends on NET
	select NETUTILS_NETLIB
	---help---
		Enable a small NSH command used to bring up and inspect the STA
		side of the NuttX sim Wi-Fi hwsim experiment.

if EXAMPLES_WIFI_HWSIM_STA

config EXAMPLES_WIFI_HWSIM_STA_PROGNAME
	string "Program name"
	default "wifi_sta_demo"

config EXAMPLES_WIFI_HWSIM_STA_PRIORITY
	int "STA demo task priority"
	default 100

config EXAMPLES_WIFI_HWSIM_STA_STACKSIZE
	int "STA demo stack size"
	default DEFAULT_TASK_STACKSIZE

config EXAMPLES_WIFI_HWSIM_STA_IFNAME
	string "STA interface name"
	default "wlan0"

config EXAMPLES_WIFI_HWSIM_STA_IPADDR
	string "STA IPv4 address"
	default "192.168.201.2"

config EXAMPLES_WIFI_HWSIM_STA_NETMASK
	string "STA IPv4 netmask"
	default "255.255.255.0"

config EXAMPLES_WIFI_HWSIM_STA_SSID
	string "STA SSID"
	default "nuttx-hwsim"

config EXAMPLES_WIFI_HWSIM_STA_PEER
	string "Peer IPv4 address"
	default "192.168.201.1"

endif
```

## examples/wing_gui_demo/Kconfig
```kconfig
#
# For a description of the syntax of this configuration file,
# see the file kconfig-language.txt in the NuttX tools repository.
#

config EXAMPLES_WING_GUI_DEMO
	tristate "WING GUI standalone demo"
	default n
	select GRAPHICS_WING
	---help---
		Enable a minimal NSH-runnable WING GUI demo.

		This demo validates the WING GUI layer without requiring WING
		Desktop.  It runs as a normal application task, builds a WING GUI
		frame into an FRender command list, executes the FRender software
		backend, and optionally presents through the framebuffer adapter.

if EXAMPLES_WING_GUI_DEMO

config EXAMPLES_WING_GUI_DEMO_PROGNAME
	string "Program name"
	default "wing_gui_demo"

config EXAMPLES_WING_GUI_DEMO_PRIORITY
	int "WING GUI demo task priority"
	default 100

config EXAMPLES_WING_GUI_DEMO_STACKSIZE
	int "WING GUI demo stack size"
	default DEFAULT_TASK_STACKSIZE

config EXAMPLES_WING_GUI_DEMO_WIDTH
	int "Demo surface width"
	default 320

config EXAMPLES_WING_GUI_DEMO_HEIGHT
	int "Demo surface height"
	default 240

endif
```

## examples/wingdemo/Kconfig
```kconfig
#
# For a description of the syntax of this configuration file,
# see the file kconfig-language.txt in the NuttX tools repository.
#

menuconfig EXAMPLES_WINGDEMO
	tristate "Wing LVGL-compatible widget demo"
	default n
	depends on GRAPHICS_WING && VIDEO_FB
	---help---
		Build an NSH command named wingdemo for the Wing ECS UI stack.
		The command compiles the upstream LVGL widgets demo application
		sources unchanged and redirects their public LVGL API calls through
		the Wing compatibility facade.

if EXAMPLES_WINGDEMO

config EXAMPLES_WINGDEMO_PRIORITY
	int "wingdemo task priority"
	default 100

config EXAMPLES_WINGDEMO_STACKSIZE
	int "wingdemo stack size"
	default 16384

config EXAMPLES_WINGDEMO_FBDEV
	string "Framebuffer device path"
	default "/dev/fb0"

config EXAMPLES_WINGDEMO_FRAMES
	int "Number of frames to render"
	default 0
	---help---
		Default number of frames rendered before exiting.  The NSH command
		also accepts --frames N and -f N.  Zero means render until the
		simulator process is stopped.

config EXAMPLES_WINGDEMO_FRAME_DELAY_US
	int "Frame delay in microseconds"
	default 33000

endif # EXAMPLES_WINGDEMO
```

## graphics/frender/Kconfig
```kconfig
#
# For a description of the syntax of this configuration file,
# see the file kconfig-language.txt in the NuttX tools repository.
#

menuconfig GRAPHICS_FRENDER
	bool "Feather render backend"
	default n
	---help---
		Enable the Feather application-side render backend.

		FRender owns backend-neutral drawing commands, backend capability
		declarations, and backend dispatch through fr_execute().

		Backends include: software (RGBA8888 surface), framebuffer (direct
		/dev/fb0), NX (NX window drawing API), DMA2D, and GPU2D.

if GRAPHICS_FRENDER

config GRAPHICS_FRENDER_FB
	bool "FRender framebuffer backend"
	default y if VIDEO_FB
	depends on VIDEO_FB
	---help---
		Enable the framebuffer backend. This backend renders directly to
		/dev/fb0 mmap'd memory without an intermediate RGBA8888 surface.
		Pixel format conversion happens at write time.

config GRAPHICS_FRENDER_FB_PRESENT
	bool "FRender framebuffer present adapter (legacy)"
	default y if VIDEO_FB
	depends on VIDEO_FB
	---help---
		Legacy framebuffer present adapter. Preserved for backward
		compatibility. New code should use the framebuffer backend
		(CONFIG_GRAPHICS_FRENDER_FB) which renders directly to fbmem.

config GRAPHICS_FRENDER_NX
	bool "FRender NX backend"
	default n
	depends on NX
	---help---
		Enable the NX backend. This backend translates FRender commands
		to NX window drawing API calls (nx_fill, nx_drawline, nx_bitmap,
		etc.). Requires a running NX server and an open window.

endif
```
