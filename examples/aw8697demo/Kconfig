## graphics/wing/Kconfig
```kconfig
#
# For a description of the syntax of this configuration file,
# see the file kconfig-language.txt in the NuttX tools repository.
#

menuconfig GRAPHICS_WING
	bool "WING GUI library"
	default n
	select GRAPHICS_FRENDER
	---help---
		Enable the WING GUI library.

		WING GUI is the application-side GUI foundation for Feather.  It is
		not the WING Desktop system.  Applications may use WING GUI directly
		from NSH, init scripts, or board launchers without packaging
		themselves for WING Desktop.

if GRAPHICS_WING

config GRAPHICS_WING_INPUT_QUEUE_SIZE
	int "WING input queue size"
	default 64
	range 1 256
	---help---
		Number of raw input events that a WING GUI instance can queue
		between application ticks.

		This queue carries pointer and key input before the WING runtime
		turns them into GUI events such as click, focus, key and value
		changed notifications.

config GRAPHICS_WING_EVENT_QUEUE_SIZE
	int "WING event queue size"
	default 128
	range 1 256
	---help---
		Number of GUI events that a WING GUI instance can queue between
		dispatch passes.

		This queue should be larger than the raw input queue because one
		input event may create multiple GUI events through focus changes,
		click synthesis, key delivery, bubbling and widget value updates.

config GRAPHICS_WING_TIMER_MAX
	int "WING software timer slots"
	default 8
	range 1 256
	---help---
		Number of software timers that a WING GUI instance can keep
		active.

		WING timers are advanced by the application-owned GUI loop and are
		used for periodic UI work such as progress updates, blinking,
		delayed state changes and future widget timers.

config GRAPHICS_WING_ANIM_MAX
	int "WING animation slots"
	default 8
	range 1 256
	---help---
		Number of animations that a WING GUI instance can keep active.

		Animations are advanced by the same GUI tick path as software
		timers.  Keeping this configurable lets small boards reduce memory
		use while richer Desktop builds can reserve more animation slots.

endif
```

## testing/mm/sysresume/Kconfig
```kconfig
#
# For a description of the syntax of this configuration file,
# see the file kconfig-language.txt in the NuttX tools repository.
#

config TESTING_SYSCALL_RESUME
	tristate "Protected syscall resume test"
	default n
	---help---
		Enable a small syscall resume diagnostic.  The test exercises
		write-usleep-write sequences from ordinary task stacks so protected
		mode wake-up and syscall return bugs can be isolated from larger
		OS test suites.

if TESTING_SYSCALL_RESUME

config TESTING_SYSCALL_RESUME_PROGNAME
	string "Program name"
	default "sysresume"
	---help---
		This is the name of the program that will be used when the NSH ELF
		program is installed.

config TESTING_SYSCALL_RESUME_PRIORITY
	int "Syscall resume test task priority"
	default 100

config TESTING_SYSCALL_RESUME_STACKSIZE
	int "Syscall resume test stack size"
	default 8192

config TESTING_SYSCALL_RESUME_DELAY_USEC
	int "Default sleep delay in microseconds"
	default 5000000
	---help---
		Default usleep() delay used between the first and second write.

endif
```

## wireless/bluetooth/ble_adv/Kconfig
```kconfig
#
# For a description of the syntax of this configuration file,
# see misc/tools/kconfig-language.txt.
#

config BLE_ADV_DEMO
	tristate "BLE advertising demo"
	default n
	depends on WIRELESS_BLUETOOTH_HOST && NET_BLUETOOTH
	---help---
		Enable a small NSH command that starts/stops connectable BLE
		advertising through the NuttX Bluetooth host ioctl path.

if BLE_ADV_DEMO

config BLE_ADV_DEMO_PROGNAME
	string "BLE advertising demo program name"
	default "ble_adv"

config BLE_ADV_DEMO_PRIORITY
	int "BLE advertising demo task priority"
	default 100

config BLE_ADV_DEMO_STACKSIZE
	int "BLE advertising demo stack size"
	default DEFAULT_TASK_STACKSIZE

config BLE_ADV_DEMO_IFNAME
	string "Default Bluetooth network interface"
	default "bnep0"

config BLE_ADV_DEMO_NAME
	string "Default BLE advertising name"
	default "Feather-ESP-BLE"

endif
```

## wireless/bluetooth/ble_gatt/Kconfig
```kconfig
#
# For a description of the syntax of this configuration file,
# see misc/tools/kconfig-language.txt.
#

config BLE_GATT_DEMO
	tristate "BLE GATT server demo"
	default n
	depends on WIRELESS_BLUETOOTH_HOST && NET_BLUETOOTH
	---help---
		Enable a small NSH command that registers a minimal readable and
		writable GATT service through the NuttX Bluetooth host GATT API.

if BLE_GATT_DEMO

config BLE_GATT_DEMO_PROGNAME
	string "BLE GATT demo program name"
	default "ble_gatt"

config BLE_GATT_DEMO_PRIORITY
	int "BLE GATT demo task priority"
	default 100

config BLE_GATT_DEMO_STACKSIZE
	int "BLE GATT demo stack size"
	default DEFAULT_TASK_STACKSIZE

config BLE_GATT_DEMO_DEFAULT_VALUE
	string "Default GATT demo characteristic value"
	default "Feather GATT ready"

endif
```

## wireless/bluetooth/ble_periph/Kconfig
```kconfig
#
# For a description of the syntax of this configuration file,
# see misc/tools/kconfig-language.txt.
#

config BLE_PERIPH_DEMO
	tristate "BLE peripheral validation demo"
	default n
	depends on WIRELESS_BLUETOOTH_HOST && NET_BLUETOOTH
	---help---
		Enable a single NSH command that registers a minimal GATT server and
		starts connectable BLE advertising through the NuttX Bluetooth host.

if BLE_PERIPH_DEMO

config BLE_PERIPH_DEMO_PROGNAME
	string "BLE peripheral demo program name"
	default "ble_periph"

config BLE_PERIPH_DEMO_PRIORITY
	int "BLE peripheral demo task priority"
	default 100

config BLE_PERIPH_DEMO_STACKSIZE
	int "BLE peripheral demo stack size"
	default DEFAULT_TASK_STACKSIZE

config BLE_PERIPH_DEMO_IFNAME
	string "Default Bluetooth network interface"
	default "bnep0"

config BLE_PERIPH_DEMO_NAME
	string "Default BLE advertising name"
	default "Feather-ESP-BLE"

config BLE_PERIPH_DEMO_DEFAULT_VALUE
	string "Default GATT demo characteristic value"
	default "Feather peripheral ready"

endif
```

## wireless/esp_hosted_ng/Kconfig
```kconfig
#
# For a description of the syntax of this configuration file,
# see the file kconfig-language.txt in the NuttX tools repository.
#

menuconfig WIRELESS_ESP_HOSTED_NG
	bool "ESP-Hosted NG source import"
	default n
	depends on NET
	---help---
		Stage the ESP-Hosted NG source import under
		apps/wireless/esp_hosted_ng/upstream.  The upstream host side is a
		Linux kernel module; the NuttX-facing driver glue lives under
		nuttx/drivers/wireless/esp_hosted_ng.

if WIRELESS_ESP_HOSTED_NG

config WIRELESS_ESP_HOSTED_NG_SPI
	bool "Use ESP-Hosted NG over SPI"
	default y
	---help---
		Select the ESP-Hosted NG SPI transport.  The ESP32-C5 firmware must
		be built with CONFIG_ESP_SPI_HOST_INTERFACE=y.

config WIRELESS_ESP_HOSTED_NG_UPSTREAM_PATH
	string "ESP-Hosted NG upstream source path"
	default "apps/wireless/esp_hosted_ng/upstream"
	---help---
		Path to the imported ESP-Hosted NG source tree inside this
		FeatherCore_ESP checkout.

endif # WIRELESS_ESP_HOSTED_NG
```

## wireless/linux_bluetooth/Kconfig
```kconfig
#
# For a description of the syntax of this configuration file,
# see misc/tools/kconfig-language.txt.
#

menu "Linux Bluetooth port tools"
	depends on NET_LINUX_BLUETOOTH

config LINUX_BTCTL
	tristate "Linux Bluetooth control tool"
	default y
	depends on NET_LINUX_BLUETOOTH
	---help---
		Enable btctl, the NSH command frontend for the Linux-semantics
		Bluetooth stack port.  This is a user-space validation/control
		tool; Linux kernel behavior belongs under nuttx/wireless or
		nuttx/drivers, not in this app.

if LINUX_BTCTL

config LINUX_BTCTL_PROGNAME
	string "btctl program name"
	default "btctl"

config LINUX_BTCTL_PRIORITY
	int "btctl task priority"
	default 100

config LINUX_BTCTL_STACKSIZE
	int "btctl stack size"
	default DEFAULT_TASK_STACKSIZE

endif

config LINUX_BTBNEPTEST
	tristate "Linux Bluetooth BNEP network-profile test tool"
	default y
	depends on NET_LINUX_BLUETOOTH
	---help---
		Enable btbneptest, a BlueZ bneptest-like NSH command for
		validating the Linux BNEP socket/ioctl shape from user space.
		This is intentionally separate from btctl so the network profile
		path can move toward BlueZ/BNEPCONNADD fd handoff semantics while
		btctl remains the lower-level probe/control tool.

if LINUX_BTBNEPTEST

config LINUX_BTBNEPTEST_PROGNAME
	string "btbneptest program name"
	default "btbneptest"

config LINUX_BTBNEPTEST_PRIORITY
	int "btbneptest task priority"
	default 100

config LINUX_BTBNEPTEST_STACKSIZE
	int "btbneptest stack size"
	default DEFAULT_TASK_STACKSIZE

endif

source "$APPSDIR/wireless/linux_bluetooth/bluez/Kconfig"

config LINUX_BTAUDIO
	tristate "Linux Bluetooth audio tool"
	default y
	depends on NET_LINUX_BLUETOOTH_A2DP || NET_LINUX_BLUETOOTH_ISO
	---help---
		Enable btaudio, the NSH command frontend for A2DP and LE Audio
		paths in the Linux-semantics Bluetooth stack port.  This stays in
		apps because it is user-space orchestration and validation, not a
		kernel Bluetooth protocol implementation.

if LINUX_BTAUDIO

config LINUX_BTAUDIO_PROGNAME
	string "btaudio program name"
	default "btaudio"

config LINUX_BTAUDIO_PRIORITY
	int "btaudio task priority"
	default 100

config LINUX_BTAUDIO_STACKSIZE
	int "btaudio stack size"
	default DEFAULT_TASK_STACKSIZE

endif

config LINUX_BTVHCID
	tristate "Linux Bluetooth VHCI hwsim bridge daemon"
	default y
	depends on NET_LINUX_BLUETOOTH
	---help---
		Enable btvhcid, a user-space VHCI/hwsim event pump for the
		Linux-semantics Bluetooth stack port.  It stays in apps because it
		is orchestration between a userspace-facing VHCI endpoint and the
		SIM hwsim public-file medium; protocol behavior remains in the
		imported Linux kernel stack under nuttx.

if LINUX_BTVHCID

config LINUX_BTVHCID_PROGNAME
	string "btvhcid program name"
	default "btvhcid"

config LINUX_BTVHCID_PRIORITY
	int "btvhcid task priority"
	default 100

config LINUX_BTVHCID_STACKSIZE
	int "btvhcid stack size"
	default 8192

endif

endmenu
```
