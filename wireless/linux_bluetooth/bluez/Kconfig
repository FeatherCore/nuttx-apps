## wireless/linux_bluetooth/bluez/Kconfig
```kconfig
menu "BlueZ userspace port"
	depends on NET_LINUX_BLUETOOTH

config LINUX_BLUEZ_PORT
	bool "Full BlueZ userspace port root"
	default y
	depends on NET_LINUX_BLUETOOTH
	---help---
		Enable the apps-side BlueZ port root.  The complete upstream BlueZ
		source is exposed under apps/wireless/linux_bluetooth/bluez/upstream,
		while NuttX-specific executable adapters and shims live under this
		bluez subtree.

config LINUX_BLUEZ_BNEPTEST
	tristate "BlueZ bneptest compatibility tool"
	default y
	depends on LINUX_BLUEZ_PORT
	---help---
		Enable bluezbneptest, the first apps-side BlueZ tool adapter for
		the Linux Bluetooth port.  It follows the BlueZ tools/bneptest.c
		network-profile shape closely enough to verify the native fd
		handoff boundary: connected L2CAP socket fd passed to BNEPCONNADD,
		then BNEP connlist/conninfo/conndel cleanup.

if LINUX_BLUEZ_BNEPTEST

config LINUX_BLUEZ_BNEPTEST_PROGNAME
	string "bluezbneptest program name"
	default "bluezbneptest"

config LINUX_BLUEZ_BNEPTEST_PRIORITY
	int "bluezbneptest task priority"
	default 100

config LINUX_BLUEZ_BNEPTEST_STACKSIZE
	int "bluezbneptest stack size"
	default DEFAULT_TASK_STACKSIZE

endif

config LINUX_BLUEZ_NETWORK
	tristate "BlueZ Network Profile-shaped adapter"
	default y
	depends on LINUX_BLUEZ_PORT
	---help---
		Enable blueznetwork, a BlueZ profiles/network-shaped adapter.
		It follows the connection.c + bnep.c lifecycle more closely than
		the standalone bneptest tool: profile connect creates a connected
		L2CAP socket, passes that fd to BNEPCONNADD with the BlueZ
		BNEP_SETUP_RESPONSE flag, exposes status, and disconnects through
		BNEPCONNDEL.

if LINUX_BLUEZ_NETWORK

config LINUX_BLUEZ_NETWORK_PROGNAME
	string "blueznetwork program name"
	default "blueznetwork"

config LINUX_BLUEZ_NETWORK_PRIORITY
	int "blueznetwork task priority"
	default 100

config LINUX_BLUEZ_NETWORK_STACKSIZE
	int "blueznetwork stack size"
	default DEFAULT_TASK_STACKSIZE

endif

config LINUX_BLUEZ_IPSP
	tristate "BlueZ LE IPSP Profile-shaped adapter"
	default y
	depends on LINUX_BLUEZ_PORT && NET_LINUX_BLUETOOTH_6LOWPAN_BRIDGE
	---help---
		Enable bluezipsp, a BlueZ-facing LE IPSP profile adapter for
		BLE 6LoWPAN/IP networking validation.  It drives the imported
		Linux Bluetooth 6LoWPAN path through an apps-side BlueZ-shaped
		connect/status/disconnect surface instead of the low-level btctl
		probe command.

if LINUX_BLUEZ_IPSP

config LINUX_BLUEZ_IPSP_PROGNAME
	string "bluezipsp program name"
	default "bluezipsp"

config LINUX_BLUEZ_IPSP_PRIORITY
	int "bluezipsp task priority"
	default 100

config LINUX_BLUEZ_IPSP_STACKSIZE
	int "bluezipsp stack size"
	default DEFAULT_TASK_STACKSIZE

endif

config LINUX_BLUEZ_GATT
	tristate "BlueZ GATT/ATT Profile-shaped adapter"
	default y
	depends on LINUX_BLUEZ_PORT
	---help---
		Enable bluezgatt, a BlueZ-facing GATT/ATT adapter for generic
		BLE attribute profile validation.  This is intentionally
		separate from the LE Audio tool so GATT can converge toward
		shared/att.c, shared/gatt-db.c, shared/gatt-client.c, and
		shared/gatt-server.c semantics as its own profile surface.

if LINUX_BLUEZ_GATT

config LINUX_BLUEZ_GATT_PROGNAME
	string "bluezgatt program name"
	default "bluezgatt"

config LINUX_BLUEZ_GATT_PRIORITY
	int "bluezgatt task priority"
	default 100

config LINUX_BLUEZ_GATT_STACKSIZE
	int "bluezgatt stack size"
	default DEFAULT_TASK_STACKSIZE

endif

config LINUX_BLUEZ_HID
	tristate "BlueZ HID/HOGP Profile-shaped adapter"
	default y
	depends on LINUX_BLUEZ_PORT
	---help---
		Enable bluezhid, a BlueZ-facing HID and HID-over-GATT adapter.
		It provides an independent apps-side closeout surface for
		profiles/input/device.c, server.c, hog.c, hog-lib.c, Linux HIDP,
		and the ATT/GATT report path instead of relying only on the
		aggregate bluezdaemon profile marker.

if LINUX_BLUEZ_HID

config LINUX_BLUEZ_HID_PROGNAME
	string "bluezhid program name"
	default "bluezhid"

config LINUX_BLUEZ_HID_PRIORITY
	int "bluezhid task priority"
	default 100

config LINUX_BLUEZ_HID_STACKSIZE
	int "bluezhid stack size"
	default DEFAULT_TASK_STACKSIZE

endif

config LINUX_BLUEZ_HFP
	tristate "BlueZ HFP/HSP Profile-shaped adapter"
	default y
	depends on LINUX_BLUEZ_PORT
	---help---
		Enable bluezhfp, a BlueZ-facing Hands-Free/Headset adapter.
		It provides an independent apps-side closeout surface for
		HFP HF/AG and HSP HS/AG roles, including RFCOMM-shaped AT
		transactions and SCO-like audio bearer evidence, instead of
		relying only on the aggregate bluezdaemon profile marker.

if LINUX_BLUEZ_HFP

config LINUX_BLUEZ_HFP_PROGNAME
	string "bluezhfp program name"
	default "bluezhfp"

config LINUX_BLUEZ_HFP_PRIORITY
	int "bluezhfp task priority"
	default 100

config LINUX_BLUEZ_HFP_STACKSIZE
	int "bluezhfp stack size"
	default DEFAULT_TASK_STACKSIZE

endif

config LINUX_BLUEZ_OBEX
	tristate "BlueZ OBEX Profile-shaped adapter"
	default y
	depends on LINUX_BLUEZ_PORT
	---help---
		Enable bluezobex, a BlueZ obexd-facing adapter for PBAP, OPP,
		MAP, MNS, FTP, Sync, and BIP closeout.  It drives OBEX
		transactions over an RFCOMM-shaped Linux Bluetooth L2CAP bearer
		so the hwsim cases no longer rely only on aggregate bluezdaemon
		profile markers for OBEX coverage.

if LINUX_BLUEZ_OBEX

config LINUX_BLUEZ_OBEX_PROGNAME
	string "bluezobex program name"
	default "bluezobex"

config LINUX_BLUEZ_OBEX_PRIORITY
	int "bluezobex task priority"
	default 100

config LINUX_BLUEZ_OBEX_STACKSIZE
	int "bluezobex stack size"
	default DEFAULT_TASK_STACKSIZE

endif

config LINUX_BLUEZ_PROFILE
	tristate "BlueZ remaining profile-shaped closeout adapter"
	default y
	depends on LINUX_BLUEZ_PORT
	---help---
		Enable bluezprofile, a profile-shaped closeout adapter for the
		remaining profile families that still need independent hwsim
		evidence: Mesh, ASHA, MIDI, Ranging, Print, and iAP.  This keeps
		the closeout surface explicit while the compatibility glue is
		gradually replaced with more direct upstream BlueZ ownership.

if LINUX_BLUEZ_PROFILE

config LINUX_BLUEZ_PROFILE_PROGNAME
	string "bluezprofile program name"
	default "bluezprofile"

config LINUX_BLUEZ_PROFILE_PRIORITY
	int "bluezprofile task priority"
	default 100

config LINUX_BLUEZ_PROFILE_STACKSIZE
	int "bluezprofile stack size"
	default DEFAULT_TASK_STACKSIZE

endif

config LINUX_BLUEZ_A2DP
	tristate "BlueZ A2DP Profile-shaped closeout adapter"
	default y
	depends on LINUX_BLUEZ_PORT
	---help---
		Enable blueza2dp, an A2DP profile closeout adapter that keeps
		AVDTP signaling, media bearer, MediaTransport ownership, SBC
		codec policy, stream lifecycle, cleanup, and upstream source
		coverage in one hwsim-verifiable command.

if LINUX_BLUEZ_A2DP

config LINUX_BLUEZ_A2DP_PROGNAME
	string "blueza2dp program name"
	default "blueza2dp"

config LINUX_BLUEZ_A2DP_PRIORITY
	int "blueza2dp task priority"
	default 100

config LINUX_BLUEZ_A2DP_STACKSIZE
	int "blueza2dp stack size"
	default DEFAULT_TASK_STACKSIZE

endif

config LINUX_BLUEZ_LEAUDIO
	tristate "BlueZ LE Audio Profile-shaped closeout adapter"
	default y
	depends on LINUX_BLUEZ_PORT
	---help---
		Enable bluezleaudio, a single-entry LE Audio closeout adapter
		for BAP/PACS/ASCS/GATT, ISO media, MediaTransport ownership,
		LC3 policy, cleanup, and upstream source coverage evidence.

if LINUX_BLUEZ_LEAUDIO

config LINUX_BLUEZ_LEAUDIO_PROGNAME
	string "bluezleaudio program name"
	default "bluezleaudio"

config LINUX_BLUEZ_LEAUDIO_PRIORITY
	int "bluezleaudio task priority"
	default 100

config LINUX_BLUEZ_LEAUDIO_STACKSIZE
	int "bluezleaudio stack size"
	default DEFAULT_TASK_STACKSIZE

endif

config LINUX_BLUEZ_MGMT
	tristate "BlueZ mgmt control client"
	default y
	depends on LINUX_BLUEZ_PORT
	---help---
		Enable bluezmgmt, a BlueZ-style mgmt control client that uses
		AF_BLUETOOTH/BTPROTO_HCI with HCI_CHANNEL_CONTROL to drive the
		NuttX Linux Bluetooth port through the same socket ABI expected
		by BlueZ user space.

if LINUX_BLUEZ_MGMT

config LINUX_BLUEZ_MGMT_PROGNAME
	string "bluezmgmt program name"
	default "bluezmgmt"

config LINUX_BLUEZ_MGMT_PRIORITY
	int "bluezmgmt task priority"
	default 100

config LINUX_BLUEZ_MGMT_STACKSIZE
	int "bluezmgmt stack size"
	default DEFAULT_TASK_STACKSIZE

endif

config LINUX_BLUEZ_DAEMON
	tristate "BlueZ bluetoothd-shaped mgmt daemon smoke"
	default y
	depends on LINUX_BLUEZ_PORT
	---help---
		Enable bluezdaemon, a daemon-shaped BlueZ adapter that keeps a
		long-lived AF_BLUETOOTH/BTPROTO_HCI mgmt control socket and drives
		the same controller initialization, discovery, pairing, connection
		info, and disconnect sequence that bluetoothd would issue through
		src/main.c and src/adapter.c.  This is an incremental entry point
		toward the full bluetoothd/profile port, not a replacement for the
		complete upstream daemon.

if LINUX_BLUEZ_DAEMON

config LINUX_BLUEZ_DAEMON_PROGNAME
	string "bluezdaemon program name"
	default "bluezdaemon"

config LINUX_BLUEZ_DAEMON_PRIORITY
	int "bluezdaemon task priority"
	default 100

config LINUX_BLUEZ_DAEMON_STACKSIZE
	int "bluezdaemon stack size"
	default DEFAULT_TASK_STACKSIZE

endif

config LINUX_BLUEZ_AUDIO
	tristate "BlueZ audio profile-shaped socket smoke"
	default y
	depends on LINUX_BLUEZ_PORT
	---help---
		Enable bluezaudio, a BlueZ profile-shaped audio adapter that
		drives the Linux Bluetooth L2CAP and ISO socket paths from the
		apps/wireless/linux_bluetooth/bluez subtree.  It is an incremental
		bridge toward the full BlueZ A2DP and LE Audio profile plugins,
		and currently validates synthetic media payload transport over the
		NuttX Linux-BT/VHCI/hwsim path.

if LINUX_BLUEZ_AUDIO

config LINUX_BLUEZ_AUDIO_PROGNAME
	string "bluezaudio program name"
	default "bluezaudio"

config LINUX_BLUEZ_AUDIO_PRIORITY
	int "bluezaudio task priority"
	default 100

config LINUX_BLUEZ_AUDIO_STACKSIZE
	int "bluezaudio stack size"
	default DEFAULT_TASK_STACKSIZE

config LINUX_BLUEZ_AUDIO_LIBSBC
	bool "Use real libsbc backend for BlueZ A2DP SBC"
	default n
	---help---
		Enable this only after an SBC codec implementation has been
		imported into the NuttX apps tree and wired into the
		bluezaudio build.  When disabled, the A2DP hwsim gate must
		report the deterministic SBC-frame backend instead of claiming
		a real libsbc encode/decode path.

endif

config LINUX_BLUEZ_BTMON
	tristate "BlueZ btmon monitor client"
	default y
	depends on LINUX_BLUEZ_PORT
	---help---
		Enable bluezbtmon, a BlueZ btmon-style monitor client that uses
		AF_BLUETOOTH/BTPROTO_HCI with HCI_CHANNEL_MONITOR to verify the
		HCI monitor socket ABI and observe mgmt control activity.

if LINUX_BLUEZ_BTMON

config LINUX_BLUEZ_BTMON_PROGNAME
	string "bluezbtmon program name"
	default "bluezbtmon"

config LINUX_BLUEZ_BTMON_PRIORITY
	int "bluezbtmon task priority"
	default 100

config LINUX_BLUEZ_BTMON_STACKSIZE
	int "bluezbtmon stack size"
	default DEFAULT_TASK_STACKSIZE

endif

config LINUX_BLUEZ_HCIIOCTL
	tristate "BlueZ HCI ioctl client"
	default y
	depends on LINUX_BLUEZ_PORT
	---help---
		Enable bluezhciioctl, a BlueZ hciconfig-style client that uses
		AF_BLUETOOTH/BTPROTO_HCI and HCI ioctl commands such as
		HCIGETDEVLIST, HCIGETDEVINFO, HCIDEVUP, HCIDEVDOWN,
		HCIDEVRESET, and HCIDEVRESTAT.

if LINUX_BLUEZ_HCIIOCTL

config LINUX_BLUEZ_HCIIOCTL_PROGNAME
	string "bluezhciioctl program name"
	default "bluezhciioctl"

config LINUX_BLUEZ_HCIIOCTL_PRIORITY
	int "bluezhciioctl task priority"
	default 100

config LINUX_BLUEZ_HCIIOCTL_STACKSIZE
	int "bluezhciioctl stack size"
	default DEFAULT_TASK_STACKSIZE

endif

config LINUX_BLUEZ_HCIRAW
	tristate "BlueZ HCI raw command client"
	default y
	depends on LINUX_BLUEZ_PORT
	---help---
		Enable bluezhciraw, a BlueZ hcitool-style client that uses
		AF_BLUETOOTH/BTPROTO_HCI with HCI_CHANNEL_RAW, HCI_FILTER
		sockopts, and raw HCI command/event traffic.

if LINUX_BLUEZ_HCIRAW

config LINUX_BLUEZ_HCIRAW_PROGNAME
	string "bluezhciraw program name"
	default "bluezhciraw"

config LINUX_BLUEZ_HCIRAW_PRIORITY
	int "bluezhciraw task priority"
	default 100

config LINUX_BLUEZ_HCIRAW_STACKSIZE
	int "bluezhciraw stack size"
	default DEFAULT_TASK_STACKSIZE

endif

endmenu
```

## wireless/wifi/Kconfig
```kconfig
#
# For a description of the syntax of this configuration file,
# see the file kconfig-language.txt in the NuttX tools repository.
#

menuconfig WIRELESS_WIFI_PORTS
	bool "Linux Wi-Fi userspace ports"
	default n
	depends on NET
	---help---
		Stage imported Linux Wi-Fi userspace components under
		apps/wireless/wifi.  These ports are intended to talk to the
		nl80211/cfg80211/mac80211 implementation staged under
		nuttx/wireless/ieee80211.

if WIRELESS_WIFI_PORTS

config WIRELESS_WIFI_LIBNL
	bool "Build libnl 3.2.25"
	default n
	---help---
		Build the libnl 3.2.25 source import under
		apps/wireless/wifi/libnl-3.2.25 with the common NuttX Wi-Fi port
		headers.

config WIRELESS_WIFI_WPA_SUPPLICANT
	bool "Build wpa_supplicant 2.11"
	default n
	select WIRELESS_WIFI_LIBNL
	---help---
		Build wpa_supplicant 2.11 from the source import kept under
		apps/wireless/wifi/wpa_supplicant-2.11.

if WIRELESS_WIFI_WPA_SUPPLICANT

config WIRELESS_WIFI_WPA_SUPPLICANT_STACKSIZE
	int "wpa_supplicant stack size"
	default 65536 if ARCH_SIM
	default 16384
	---help---
		Stack size used when wpa_supplicant is started from NSH. The
		Linux userspace port executes RSN/EAPOL processing, libnl glue,
		and driver callbacks in this task, so the default is larger than
		the generic NuttX task stack.

config WIRELESS_WIFI_WPA_CLI_STACKSIZE
	int "wpa_cli stack size"
	default 16384 if ARCH_SIM
	default DEFAULT_TASK_STACKSIZE
	---help---
		Stack size used by wpa_cli.

config WIRELESS_WIFI_WPA_PASSPHRASE_STACKSIZE
	int "wpa_passphrase stack size"
	default 16384 if ARCH_SIM
	default DEFAULT_TASK_STACKSIZE
	---help---
		Stack size used by wpa_passphrase.

endif # WIRELESS_WIFI_WPA_SUPPLICANT

config WIRELESS_WIFI_HOSTAPD
	bool "Build hostapd 2.11"
	default n
	select WIRELESS_WIFI_LIBNL
	---help---
		Build hostapd 2.11 from the source import kept under
		apps/wireless/wifi/hostapd-2.11.

if WIRELESS_WIFI_HOSTAPD

config WIRELESS_WIFI_HOSTAPD_STACKSIZE
	int "hostapd stack size"
	default 65536 if ARCH_SIM
	default 16384
	---help---
		Stack size used when hostapd is started from NSH.

config WIRELESS_WIFI_HOSTAPD_CLI_STACKSIZE
	int "hostapd_cli stack size"
	default 16384 if ARCH_SIM
	default DEFAULT_TASK_STACKSIZE
	---help---
		Stack size used by hostapd_cli.

endif # WIRELESS_WIFI_HOSTAPD

config WIRELESS_WIFI_BUILD_EXPERIMENTAL
	bool "Build staged Wi-Fi userspace ports"
	default n
	select WIRELESS_WIFI_LIBNL
	select WIRELESS_WIFI_WPA_SUPPLICANT
	select WIRELESS_WIFI_HOSTAPD
	---help---
		Compile the staged Wi-Fi userspace support, including libnl,
		wpa_supplicant, and hostapd.

endif # WIRELESS_WIFI_PORTS
```
